## Kconfig
```kconfig
#
# For a description of the syntax of this configuration file,
# see the file kconfig-language.txt in the NuttX tools repository.
#

config EXAMPLES_IMPULSEXX
	tristate "Impulse response C++ example"
	default n
	depends on CXD56_AUDIO
	---help---
		Enable the \"Hello, World!\" C++ example
		
#shit ported from the Audio player
if EXAMPLES_IMPULSEXX

choice
	prompt "Output device selection"
	default EXAMPLES_IMPULSEXX_OUTPUT_DEV_SPHP
	---help---
		Set the device type of output to use

config EXAMPLES_IMPULSEXX_OUTPUT_DEV_SPHP
	bool "Speaker/Headphone output"

config EXAMPLES_IMPULSEXX_OUTPUT_DEV_I2S
	bool "I2S output"
endchoice

choice
	prompt "player mode selection"
	default EXAMPLES_IMPULSEXX_MODE_NORMAL
	---help---
		Set the operation mode of player capability.
		To play include Hi-Res file, select Hi-Res mode.
		If it is not Hi-Res file, select Normal mode.

config EXAMPLES_IMPULSEXX_MODE_NORMAL
	bool "Normal mode"

config EXAMPLES_IMPULSEXX_MODE_HIRES
	bool "Hi-Res mode"
endchoice

config EXAMPLES_IMPULSEXX_USEPOSTPROC
    bool "Use Posstprocess"
    default n

config EXAMPLES_IMPULSEXX_PROGNAME
	string "Program name"
	default "impulsexx"

config EXAMPLES_IMPULSEXX_PRIORITY
	int "Audio player task priority"
	default 150

config EXAMPLES_IMPULSEXX_STACKSIZE
	int "Audio player stack size"
	default 2048
endif
```
